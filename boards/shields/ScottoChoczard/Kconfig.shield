## boards/shields/ScottoChoczard/Kconfig.shield
```kconfig
config SHIELD_SCOTTOCHOCZARD_LEFT
    def_bool $(shields_list_contains,ScottoChoczard_left)

config SHIELD_SCOTTOCHOCZARD_RIGHT
    def_bool $(shields_list_contains,ScottoChoczard_right)
```
